## sw/i2c_simple/main/Kconfig.projbuild
```kconfig
menu "Project Configuration"

    config I2C_MASTER_SCL
        int "SCL GPIO Num"
        default 22
        help
            GPIO number for I2C Master clock line.

    config I2C_MASTER_SDA
        int "SDA GPIO Num"
        default 21
        help
            GPIO number for I2C Master data line.

    config WIFI_SSID
        string "WiFi SSID"
        default "mywifissid"
        help
            SSID of network to connect to.

    config WIFI_PASSWORD
        string "WiFi Password"
        default "mypassword"
        help
            WiFi password (WPA or WPA2) of the network to connect to.

    config SMARTBULB_IP_ADDRESS
        string "SmartBulb IP Address"
        default "192.168.1.100"
        help
            IP address of the TP-Link Kasa Smart Bulb to connect to.

endmenu
```
